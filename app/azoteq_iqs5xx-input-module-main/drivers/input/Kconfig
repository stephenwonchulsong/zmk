## app/azoteq_iqs5xx-input-module-main/drivers/input/Kconfig
```kconfig
# Copyright (c) 2022 The ZMK Contributors
# SPDX-License-Identifier: MIT

menuconfig INPUT_IQS5XX
    bool "IQS5XX trackpad"
    default y
    depends on GPIO
    depends on SPI || I2C
    depends on INPUT
    depends on DT_HAS_IQS5XX_ENABLED
    help
      Enable driver for IQS5XX trackpads

if INPUT_PINNACLE

config INPUT_PINNACLE_INIT_PRIORITY
    int "IQS5XX initialization priority"
    default INPUT_INIT_PRIORITY

if ZMK_MOUSE

config ZMK_INPUT_IQS5XX_IDLE_SLEEPER
    bool "IQS5XX Sleep linked to ZMK idle state"
    default n

endif

endif
```

## app/azoteq_iqs5xx-input-module-main/dts/bindings/input/iqs5xx-i2c.yaml
```yaml
description: |
  Sensor driver for the iqs5xx, using the I2C interface

compatible: "azoteq,iqs5xx"

include: ["i2c-device.yaml", "iqs5xx-common.yaml"]
```

## app/azoteq_iqs5xx-input-module-main/dts/bindings/input/iqs5xx-spi.yaml
```yaml
description: |
  Sensor driver for the iqs5xx, using the SPI interface

compatible: "iqs5xx"

include: ["spi-device.yaml", "iqs5xx-common.yaml"]
```

## app/boards/arm/bbq10/Kconfig.bbq10
```kconfig
# Copyright (c) 2025 ZitaoTech
# SPDX-License-Identifier: MIT

config BOARD_BBQ10
    select SOC_NRF52840_QIAA

menu "Backlight and LED options"

config TRACKPAD_LED_BRIGHTNESS
    int "Trackpad LED brightness when CapsLock is on"
    default 90
    range 0 100
    help
      The brightness value (0-100) to set the Trackpad LED when Caps Lock is active.

endmenu

menu "A320 Trackpad Setting"

config A320_TRACKPAD_SCROLL_INTERVAL
    int "Trackpad scroll in miliseconds"
    default 50
    range 0 200
    help
      The bigger this value, the slower the trackpad scrolls

config A320_TRACKPAD_SPEEDMULTIPLIER_VERTICAL
    int "Trackpad speed multiplier y"
    default 100
    range 1 100
    help
      from 1 to 100

config A320_TRACKPAD_SPEEDMULTIPLIER_HORIZONTAL
    int "Trackpad speed multiplier x"
    default 100
    range 1 100
    help
      from 1 to 100

config A320_LOG_LEVEL
  int "Log Level for Touch"
  default 4

config A320
  bool "A320 Driver"
  depends on I2C && GPIO
  help
    Projected capacitive trackpad/touchscreen controller.

config INPUT_A320_INIT_PRIORITY
  int "A320 Initialization Priority"
  default 90

endmenu
```

## app/boards/shields/35chambers/Kconfig.defconfig
```kconfig
if SHIELD_35CHAMBERS_LEFT

config ZMK_KEYBOARD_NAME
	default "35chambers"

config ZMK_SPLIT_BLE_ROLE_CENTRAL
	default y

endif

if SHIELD_35CHAMBRS_LEFT || SHIELD_35CHAMBERS_RIGHT

config ZMK_SPLIT
	default y

endif
```

## app/boards/shields/35chambers/Kconfig.shield
```kconfig
config SHIELD_35CHAMBERS_LEFT
	def_bool $(shields_list_contains,35chambers_left)

config SHIELD_35CHAMBERS_RIGHT
	def_bool $(shields_list_contains,35chambers_right)
```

## app/boards/shields/369p/Kconfig.defconfig
```kconfig
if SHIELD_369P_LEFT || SHIELD_369P_RIGHT

config ZMK_SPLIT
	default y
config SPI
    default y
config I2C
	default y
config ZMK_POINTING
    default y
endif

if SHIELD_369P_RIGHT

config ZMK_KEYBOARD_NAME
	default "369p"

config ZMK_SPLIT_BLE_ROLE_CENTRAL
	default y

endif
```

## app/boards/shields/36Cirque/Kconfig.defconfig
```kconfig
if 36CIRQUE

config ZMK_KEYBOARD_NAME
    default "36cirque"

# Cirque Glidepoint trackpad
config ZMK_POINTING
    default y

# Assuming pointing device uses SPI
config SPI
    default y
endif
```

## app/boards/shields/36Cirque2/Kconfig.defconfig
```kconfig
if 36CIRQUE2

config ZMK_KEYBOARD_NAME
    default "36cirque2"

# Cirque Glidepoint trackpad
config ZMK_POINTING
    default y

# Assuming pointing device uses SPI
config SPI
    default y

endif
```

## app/boards/shields/36CirqueNN/Kconfig.defconfig
```kconfig
if 36CIRQUENN

config ZMK_KEYBOARD_NAME
    default "36cirqueNN"

# Cirque Glidepoint trackpad
config ZMK_POINTING
    default y

# Assuming pointing device uses SPI
config SPI
    default y
endif
```

## app/boards/shields/36cEC11y/Kconfig.defconfig
```kconfig
if SHIELD_36cEC11y_LEFT

config ZMK_KEYBOARD_NAME
	default "36cEC11y"

config ZMK_SPLIT_BLE_ROLE_CENTRAL
	default y

endif

if SHIELD_36CEC11Y_LEFT || SHIELD_36CEC11Y_RIGHT

config ZMK_SPLIT
	default y

endif
```

## app/boards/shields/36cEC11y/Kconfig.shield
```kconfig
config SHIELD_36CEC11Y_LEFT
	def_bool $(shields_list_contains,36cEC11y_left)

config SHIELD_36CEC11Y_RIGHT
	def_bool $(shields_list_contains,36cEC11y_right)
```

## app/boards/shields/36ch9ulp/Kconfig.defconfig
```kconfig
if SHIELD_36CH9ULP_LEFT || SHIELD_36CH9ULP_RIGHT

config ZMK_SPLIT
	default y
config SPI
    default y
config I2C
	default y
config ZMK_POINTING
    default y
endif

if SHIELD_36CH9ULP_RIGHT

config ZMK_KEYBOARD_NAME
	default "36ch9ulp"

config ZMK_SPLIT_BLE_ROLE_CENTRAL
	default y

endif
```

## app/boards/shields/36ch9ulp/Kconfig.shield
```kconfig
config SHIELD_36CH9ULP_LEFT
	def_bool $(shields_list_contains,36ch9ulp_left)

config SHIELD_36CH9ULP_RIGHT
	def_bool $(shields_list_contains,36ch9ulp_right)
```

## app/boards/shields/36chambers/369p/Kconfig.shield
```kconfig
config SHIELD_369P_LEFT
	def_bool $(shields_list_contains,369p_left)

config SHIELD_369P_RIGHT
	def_bool $(shields_list_contains,369p_right)
```

## app/boards/shields/36chambers/369ulp/Kconfig.defconfig
```kconfig
if SHIELD_369ULP_LEFT || SHIELD_369ULP_RIGHT || SHIELD_369ULP_TP

config ZMK_SPLIT
	default y
config SPI
	default y
config I2C
	default y
config ZMK_POINTING
	default y

endif

if SHIELD_369ULP_LEFT

config ZMK_KEYBOARD_NAME
	default "36Chambers-ULP"

config ZMK_SPLIT_BLE_ROLE_CENTRAL
	default y

endif

if SHIELD_369ULP_TP

config INPUT_PINNACLE
	default y

endif
```

## app/boards/shields/36chambers/369ulp/Kconfig.shield
```kconfig
config SHIELD_369ULP_LEFT
	def_bool $(shields_list_contains,369ulp_left)

config SHIELD_369ULP_RIGHT
	def_bool $(shields_list_contains,369ulp_right)

config SHIELD_369ULP_TP
	def_bool $(shields_list_contains,369ulp_tp)
```

## app/boards/shields/36chambers/369ulptp/Kconfig.defconfig
```kconfig
if SHIELD_369ULPTP_LEFT || SHIELD_369ULPTP_RIGHT || SHIELD_369ULPTP_TP

config ZMK_SPLIT
	default y
config SPI
	default y
config I2C
	default y
config ZMK_POINTING
	default y

endif

if SHIELD_369ULPTP_RIGHT

config ZMK_KEYBOARD_NAME
	default "36Chambers-ULPTP"

config ZMK_SPLIT_BLE_ROLE_CENTRAL
	default y

endif

if SHIELD_369ULPTP_TP

config INPUT_PINNACLE
	default y

endif
```

## app/boards/shields/36chambers/369ulptp/Kconfig.shield
```kconfig
config SHIELD_369ULPTP_LEFT
	def_bool $(shields_list_contains,369ulptp_left)

config SHIELD_369ULPTP_RIGHT
	def_bool $(shields_list_contains,369ulptp_right)

config SHIELD_369ULPTP_TP
	def_bool $(shields_list_contains,369ulptp_tp)
```

## app/boards/shields/36chambers/36chambers9ex/Kconfig.shield
```kconfig
config SHIELD_36CHAMBERS9EX_LEFT
	def_bool $(shields_list_contains,36chambers9ex_left)

config SHIELD_36CHAMBERS9EX_RIGHT
	def_bool $(shields_list_contains,36chambers9ex_right)
```

## app/boards/shields/36chambers/36chambers9sr/Kconfig.shield
```kconfig
config SHIELD_36CHAMBERS9SR_LEFT
	def_bool $(shields_list_contains,36chambers9sr_left)
    select SPI

config SHIELD_36CHAMBERS9SR_RIGHT
	def_bool $(shields_list_contains,36chambers9sr_right)
    select SPI
```
