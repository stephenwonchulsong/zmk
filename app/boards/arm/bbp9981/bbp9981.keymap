/*
 * Copyright (c) 2025 ZitaoTech
 *
 * SPDX-License-Identifier: MIT
 
 west build -d build/bbp9981 -p -b  bbp9981
 west build -d build/bbp9981_reset -p -b bbp9981 -- -DSHIELD=settings_reset
 
 docker cp naughty_cohen:/workspaces/zmk/app/build/bbp9981/zephyr/zmk.uf2 "/Users/song100/Library/Mobile Documents/com~apple~CloudDocs/Keyboard/36firmware/bbp9981.uf2"
 docker cp naughty_cohen:/workspaces/zmk/app/build/bbp9981_reset/zephyr/zmk.uf2 "/Users/song100/Library/Mobile Documents/com~apple~CloudDocs/Keyboard/36firmware/bbp9981_reset.uf2"

 */



#include <behaviors.dtsi>
#include <dt-bindings/zmk/keys.h>
#include <dt-bindings/zmk/bt.h>
#include <dt-bindings/zmk/outputs.h>
#include <dt-bindings/zmk/mouse.h>
#include <dt-bindings/zmk/backlight.h>
#include <dt-bindings/zmk/ext_power.h>
#include <dt-bindings/zmk/rgb.h>
#include <input/processors.dtsi>

#define DEFAULT 0
#define LOWER 1
#define UPPER 2
#define ADJUST 3
// #define MOUSE 4

#define SL_MO(layer) &sl_mo layer layer //tap -> sticky layer, hold -> momentary layer

&sl {
    release-after-ms = <3000>;
    };

#include "../bbq10/bb_common.keymap.dtsi"

/*
west build -d build/bbp9981 -p -b  bbp9981
west build -d build/bbp9981_reset -p -b bbp9981 -- -DSHIELD=settings_reset

docker cp zealous_pasteur:/workspaces/zmk/app/build/bbp9981/zephyr/zmk.uf2 "/Users/song100/Library/Mobile Documents/com~apple~CloudDocs/Keyboard/36firmware/bbp9981.uf2"
docker cp zealous_pasteur:/workspaces/zmk/app/build/bbp9981_reset/zephyr/zmk.uf2 "/Users/song100/Library/Mobile Documents/com~apple~CloudDocs/Keyboard/36firmware/bbp9981_reset.uf2"
*/