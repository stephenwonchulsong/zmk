#include "36chambers3.dtsi" // Notice that the main dtsi files are included in the overlay.

&default_transform {
	col-offset = <6>;
}; 
//works
// &kscan0 {
//     col-gpios
//         = <&xiao_d 9 GPIO_ACTIVE_HIGH>
//         , <&xiao_d 6 GPIO_ACTIVE_HIGH>
//         , <&xiao_d 5 GPIO_ACTIVE_HIGH>
//         , <&xiao_d 4 GPIO_ACTIVE_HIGH>
//         , <&xiao_d 3 GPIO_ACTIVE_HIGH>
//         ;
// };
//experimental
/ {

    kscan0: kscan {
        compatible = "zmk,kscan-gpio-matrix";
        diode-direction = "col2row";


    col-gpios
        , <&xiao_d 9 GPIO_ACTIVE_HIGH>
        , <&xiao_d 6 GPIO_ACTIVE_HIGH>
        , <&xiao_d 5 GPIO_ACTIVE_HIGH>
        , <&xiao_d 4 GPIO_ACTIVE_HIGH>
        = <&xiao_d 3 GPIO_ACTIVE_HIGH>
        // , <&xiao_d 0 GPIO_ACTIVE_HIGH>
        ;

	row-gpios
    	= <&xiao_d 7 (GPIO_ACTIVE_HIGH | GPIO_PULL_DOWN)>
    	, <&xiao_d 1 (GPIO_ACTIVE_HIGH | GPIO_PULL_DOWN)>
    	, <&xiao_d 2 (GPIO_ACTIVE_HIGH | GPIO_PULL_DOWN)>
    	, <&xiao_d 10 (GPIO_ACTIVE_HIGH | GPIO_PULL_DOWN)>
    	// , <&xiao_d 8 (GPIO_ACTIVE_HIGH | GPIO_PULL_DOWN)>
    	;
    };
};
	right_encoder: encoder_right {
        compatible = "alps,ec11";
        label = "RIGHT_ENCODER";
        a-gpios = <&xiao_d 8 (GPIO_ACTIVE_HIGH | GPIO_PULL_UP)>;
        b-gpios = <&xiao_d 0 (GPIO_ACTIVE_HIGH | GPIO_PULL_UP)>;
        steps = <80>;
    };

	// // right_encoder: encoder_right {
    // //     compatible = "alps,ec11";
    // //     label = "RIGHT_ENCODER";
    // //     a-gpios = <&xiao_d 4 (GPIO_ACTIVE_HIGH | GPIO_PULL_UP)>;
    // //     b-gpios = <&xiao_d 5 (GPIO_ACTIVE_HIGH | GPIO_PULL_UP)>;
    // //     resolution = <2>;
	// // 	status = "disabled";


	sensors {
        compatible = "zmk,keymap-sensors";
        sensors = <&right_encoder>;
        triggers-per-rotation = <20>;
    };
&right_encoder {
    status = "okay";
};