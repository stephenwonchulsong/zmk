## app/boards/shields/3610ulpred/Kconfig.defconfig
```kconfig
if SHIELD_3610ULPRED_LEFT || SHIELD_3610ULPRED_RIGHT || SHIELD_3610ULPRED_TP

config ZMK_SPLIT
	default y
config SPI
	default y
config I2C
	default y
config ZMK_POINTING
	default y

endif

if SHIELD_3610ULPRED_RIGHT

config ZMK_KEYBOARD_NAME
	default "3610ulpred"

config ZMK_SPLIT_ROLE_CENTRAL
	default y

endif

if SHIELD_3610ULPRED_TP

config INPUT_PINNACLE
	default y

endif
```

## app/boards/shields/3610ulpred/Kconfig.shield
```kconfig
config SHIELD_3610ULPRED_LEFT
	def_bool $(shields_list_contains,3610ulpred_left)

config SHIELD_3610ULPRED_RIGHT
	def_bool $(shields_list_contains,3610ulpred_right)

config SHIELD_3610ULPRED_TP
	def_bool $(shields_list_contains,3610ulpred_tp)
```

## app/boards/shields/3610ulptp/Kconfig.defconfig
```kconfig
if SHIELD_3610ULPTP_LEFT || SHIELD_3610ULPTP_RIGHT || SHIELD_3610ULPTP_TP

config ZMK_SPLIT
	default y
config SPI
	default y
config I2C
	default y
config ZMK_POINTING
	default y

endif

if SHIELD_3610ULPTP_RIGHT

config ZMK_KEYBOARD_NAME
	default "36ChULP10"

config ZMK_SPLIT_ROLE_CENTRAL
	default y

endif

if SHIELD_3610ULPTP_TP

config INPUT_PINNACLE
	default y

endif
```

## app/boards/shields/3610ulptp/Kconfig.shield
```kconfig
config SHIELD_3610ULPTP_LEFT
	def_bool $(shields_list_contains,3610ulptp_left)

config SHIELD_3610ULPTP_RIGHT
	def_bool $(shields_list_contains,3610ulptp_right)

config SHIELD_3610ULPTP_TP
	def_bool $(shields_list_contains,3610ulptp_tp)
```
