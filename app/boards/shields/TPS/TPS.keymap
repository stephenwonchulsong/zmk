/*
 * Copyright (c) 2020 The ZMK Contributors
 *
west build -d build/TPS -p -b seeeduino_xiao_ble -- -DSHIELD=TPS
west build -d build/TPS -p -b seeeduino_xiao_ble -- -DSHIELD=TPS -DZMK_EXTRA_MODULES="/workspaces/zmk/app/zmk-driver-azoteq-iqs5xx-main"

 * SPDX-License-Identifier: MIT
 */

#include <behaviors.dtsi>
#include <dt-bindings/zmk/keys.h>
#include <dt-bindings/zmk/bt.h>
#include <dt-bindings/zmk/outputs.h>
#include <dt-bindings/zmk/mouse.h>
#include <dt-bindings/zmk/pointing.h>



#define default 0

/ {
    // mou0_mmv_il {
    //         compatible = "zmk,input-listener";
    //         device = <&tps43>;
    //         base {
    //                 layers = <default>;
    //                 input-processors = <&zip_report_rate_limit 15>;
    //         };
    // };

    keymap {
        compatible = "zmk,keymap";

        default_layer {
            bindings = <
            &kp ESC &kp RCTL &kp LGUI &kp LSFT
            >;
        };
    };
    // mou0_mmv_il {
    //         compatible = "zmk,input-listener";
    //         device = <&tps43>;
    //         base {
    //                 layers = <default>;
    //                 input-processors = <&zip_report_rate_limit 15>;
    //         };
    // };
    // xy_transf: xy_transf {
    //         compatible = "zmk,input-processor-transform";
    //         #input-processor-cells = <1>;
    //         type = <INPUT_EV_REL>;
    //         x-codes = <INPUT_REL_X>, <INPUT_REL_WHEEL>;
    //         y-codes = <INPUT_REL_Y>, <INPUT_REL_HWHEEL>;
    // };
    // xy_scaler: xy_scaler {
    //         compatible = "zmk,input-processor-scaler";
    //         #input-processor-cells = <2>;
    //         type = <INPUT_EV_REL>;
    //         codes = <INPUT_REL_X>, <INPUT_REL_Y>;
    //         track-remainders;
    // };
    // x_scaler: x_scaler {
    //         compatible = "zmk,input-processor-scaler";
    //         #input-processor-cells = <2>;
    //         type = <INPUT_EV_REL>;
    //         codes = <INPUT_REL_X>;
    // };
    // to_wheel: to_wheel {
    //         compatible = "zmk,input-processor-code-mapper";
    //         #input-processor-cells = <0>;
    //         type = <INPUT_EV_REL>;
    //         map = <INPUT_REL_X INPUT_REL_MISC>, <INPUT_REL_Y INPUT_REL_WHEEL>;
    // };


    // behaviors {
    //         mkg: hold_mouse_key_press_tap_toggle {
    //                 compatible = "zmk,behavior-hold-tap"; #binding-cells = <2>;
    //                 tapping-term-ms = <200>; quick-tap-ms = <200>;
    //                 flavor = "tap-preferred"; bindings = <&mkp>, <&tog>;
    //         };
    //         ec_s: mouse_scroll {
    //                 compatible = "zmk,behavior-input-two-axis";
    //                 #binding-cells = <1>;
    //                 trigger-period-ms = <12>; // slow down for OTA, default is 3ms
    //                 x-input-code = <INPUT_REL_HWHEEL>;
    //                 y-input-code = <INPUT_REL_WHEEL>;
    //                 time-to-max-speed-ms = <177>;
    //                 acceleration-exponent = <0>;
    //         };
    //         rot_enc: sensor_rotate {
    //                 compatible = "zmk,behavior-sensor-rotate";
    //                 #sensor-binding-cells = <0>;
    //                 bindings = <&ec_s MOVE_Y(-37)>, <&ec_s MOVE_Y(37)>;
    //                 tap-ms = <65>;
    //         };
    // };
};