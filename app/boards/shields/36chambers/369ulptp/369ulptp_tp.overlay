// 369ulptp touchpad peripheral — Cirque Glidepoint via SPI, split peripheral.
//
// The touchpad hardware is identical to the 36cirque shield, so instead of
// duplicating the glidepoint node / input-listener / kscan / transform here,
// we include 36cirque's overlay directly. Any change to 36cirque's pin map,
// input processors, etc. is automatically picked up by this peripheral.
//
// Only the BLE split-peripheral role differs, and that lives in
// 369ulptp_tp.conf (CONFIG_ZMK_SPLIT*, CONFIG_BT*), not in the device tree.
//
// Requires the cirque module at build time:
//   -DZMK_EXTRA_MODULES="/workspaces/zmk/app/cirque-input-module-main"

#include "../36Cirque/36cirque.overlay"
