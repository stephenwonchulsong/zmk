#include "36chambers9sr.dtsi" // Notice that the main dtsi files are included in the overlay.

&default_transform {
	col-offset = <5>;
}; 

&right_encoder {
    status = "okay";
};


// / {
//     kscan0: kscan {
//         compatible = "zmk,kscan-gpio-matrix";
//         diode-direction = "col2row";
//     col-gpios
//         = <&shifter 0 GPIO_ACTIVE_HIGH>
//         , <&shifter 1 GPIO_ACTIVE_HIGH>
//         , <&shifter 2 GPIO_ACTIVE_HIGH>
//         , <&shifter 3 GPIO_ACTIVE_HIGH>
//         , <&shifter 4 GPIO_ACTIVE_HIGH>
//         ;
// 	row-gpios
//     	= <&xiao_d 0 (GPIO_ACTIVE_HIGH | GPIO_PULL_DOWN)>//Row0
//         , <&xiao_d 1 (GPIO_ACTIVE_HIGH | GPIO_PULL_DOWN)>//Row1
//         , <&xiao_d 2 (GPIO_ACTIVE_HIGH | GPIO_PULL_DOWN)>//Row2
//         , <&xiao_d 3 (GPIO_ACTIVE_HIGH | GPIO_PULL_DOWN)>//Row3
//         , <&xiao_d 9 (GPIO_ACTIVE_HIGH | GPIO_PULL_DOWN)>//Row4
//         , <&shifter 5 (GPIO_ACTIVE_HIGH | GPIO_PULL_DOWN)>
//         ;
//     };
// //     &right_encoder {
// //     status = "okay";
// // };
//     // right_encoder: encoder_right {
//     //     compatible = "alps,ec11";
//     //     a-gpios = <<&shifter 6 GPIO_ACTIVE_HIGH>;
//     //     b-gpios = <<&shifter 7 GPIO_ACTIVE_HIGH>;
//     //     steps = <80>;
//     //     status = "okay";
//     // };
// };