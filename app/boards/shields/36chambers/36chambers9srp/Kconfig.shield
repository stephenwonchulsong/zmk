## app/boards/shields/36chambers/36chambers9srp/Kconfig.shield
```kconfig
config SHIELD_36CHAMBERS9SRP_LEFT
	def_bool $(shields_list_contains,36chambers9srp_left)
    select SPI

config SHIELD_36CHAMBERS9SRP_RIGHT
	def_bool $(shields_list_contains,36chambers9srp_right)
    select SPI
```

## app/boards/shields/36chambers/Kconfig.defconfig
```kconfig
if SHIELD_36CHAMBERS_LEFT

config ZMK_KEYBOARD_NAME
	default "36Chambers"

config ZMK_SPLIT_BLE_ROLE_CENTRAL
	default y

endif

if SHIELD_36CHAMBERS_LEFT || SHIELD_36CHAMBERS_RIGHT

config ZMK_SPLIT
	default y

endif
```

## app/boards/shields/36chambers/Kconfig.shield
```kconfig
config SHIELD_36CHAMBERS_LEFT
	def_bool $(shields_list_contains,36chambers_left)

config SHIELD_36CHAMBERS_RIGHT
	def_bool $(shields_list_contains,36chambers_right)
```

## app/boards/shields/36chambers2/Kconfig.defconfig
```kconfig
if SHIELD_36CHAMBERS2_LEFT

config ZMK_KEYBOARD_NAME
	default "36Chambers2"

config ZMK_SPLIT_BLE_ROLE_CENTRAL
	default y

endif

if SHIELD_36CHAMBERS2_LEFT || SHIELD_36CHAMBERS2_RIGHT

config ZMK_SPLIT
	default y

endif
```

## app/boards/shields/36chambers2/Kconfig.shield
```kconfig
config SHIELD_36CHAMBERS2_LEFT
	def_bool $(shields_list_contains,36chambers2_left)

config SHIELD_36CHAMBERS2_RIGHT
	def_bool $(shields_list_contains,36chambers2_right)
```

## app/boards/shields/36chambers2r2_EC11n/Kconfig.defconfig
```kconfig
if SHIELD_36CHAMBERS2r2_LEFT

config ZMK_KEYBOARD_NAME
	default "36Chambers2r2"

config ZMK_SPLIT_BLE_ROLE_CENTRAL
	default y

endif

if SHIELD_36CHAMBERS2r2_LEFT || SHIELD_36CHAMBERS2r2_RIGHT

config ZMK_SPLIT
	default y

endif
```

## app/boards/shields/36chambers2r2_EC11n/Kconfig.shield
```kconfig
config SHIELD_36CHAMBERS2R2_LEFT
	def_bool $(shields_list_contains,36chambers2r2_left)

config SHIELD_36CHAMBERS2R2_RIGHT
	def_bool $(shields_list_contains,36chambers2r2_right)
```

## app/boards/shields/36chambers3/Kconfig.defconfig
```kconfig
if SHIELD_36CHAMBERS3_LEFT

config ZMK_KEYBOARD_NAME
	default "36Chambers3"

config ZMK_SPLIT_BLE_ROLE_CENTRAL
	default y

endif

if SHIELD_36CHAMBERS3_LEFT || SHIELD_36CHAMBERS3_RIGHT

config ZMK_SPLIT
	default y

endif
```

## app/boards/shields/36chambers3/Kconfig.shield
```kconfig
config SHIELD_36CHAMBERS3_LEFT
	def_bool $(shields_list_contains,36chambers3_left)

config SHIELD_36CHAMBERS3_RIGHT
	def_bool $(shields_list_contains,36chambers3_right)
```

## app/boards/shields/36chambers5/Kconfig.defconfig
```kconfig
if SHIELD_36CHAMBERS5_LEFT

config ZMK_KEYBOARD_NAME
	default "36Chambers5"

config ZMK_SPLIT_BLE_ROLE_CENTRAL
	default y

endif

if SHIELD_36CHAMBERS5_LEFT || SHIELD_36CHAMBERS5_RIGHT

config ZMK_SPLIT
	default y

endif
```

## app/boards/shields/36chambers5/Kconfig.shield
```kconfig
config SHIELD_36CHAMBERS5_LEFT
	def_bool $(shields_list_contains,36chambers5_left)

config SHIELD_36CHAMBERS5_RIGHT
	def_bool $(shields_list_contains,36chambers5_right)
```

## app/boards/shields/36chambers9/Kconfig.defconfig
```kconfig
if SHIELD_36CHAMBERS9_LEFT

config ZMK_KEYBOARD_NAME
	default "36Chambers9"

config ZMK_SPLIT_BLE_ROLE_CENTRAL
	default y

endif

if SHIELD_36CHAMBERS9_LEFT || SHIELD_36CHAMBERS9_RIGHT

config ZMK_SPLIT
	default y

config SPI
    default y

endif
```

## app/boards/shields/36chambers9/Kconfig.shield
```kconfig
config SHIELD_36CHAMBERS9R_LEFT
	def_bool $(shields_list_contains,36chambers9_left)

config SHIELD_36CHAMBERS9_RIGHT
	def_bool $(shields_list_contains,36chambers9_right)
```

## app/boards/shields/36chambers9R/Kconfig.defconfig
```kconfig
if SHIELD_36CHAMBERS9R_RIGHT

config ZMK_KEYBOARD_NAME
	default "36Chambers9R"

config ZMK_SPLIT_BLE_ROLE_CENTRAL
	default y
config SPI
    default y
endif

if SHIELD_36CHAMBERS9R_LEFT || SHIELD_36CHAMBERS9R_RIGHT

config ZMK_SPLIT
	default y

config SPI
    default y

endif
```

## app/boards/shields/36chambers9R/Kconfig.shield
```kconfig
config SHIELD_36CHAMBERS9R_LEFT
	def_bool $(shields_list_contains,36chambers9r_left)

config SHIELD_36CHAMBERS9_RIGHT
	def_bool $(shields_list_contains,36chambers9r_right)
```

## app/boards/shields/36chambers9c/Kconfig.defconfig
```kconfig
if SHIELD_36CHAMBERS9C_LEFT

config ZMK_KEYBOARD_NAME
    default "36Chambers9c"

config ZMK_SPLIT
    default y

config ZMK_POINTING
    default y

config ZMK_SPLIT_BLE_ROLE_CENTRAL
    default y

config SPI
    default n

endif

if SHIELD_36CHAMBERS9C_CIRQUE

config ZMK_POINTING
    default y

config ZMK_SPLIT
    default y

config SPI
    default y

endif

if SHIELD_36CHAMBERS9C_RIGHT

config ZMK_POINTING
    default y

config ZMK_SPLIT
    default y

config SPI
    default n

endif
```

## app/boards/shields/36chambers9c/Kconfig.shield
```kconfig
# Copyright (c) 2020 The ZMK Contributors
# SPDX-License-Identifier: MIT

config SHIELD_36CHAMBERS9C_CIRQUE
	def_bool $(shields_list_contains,36Chambers9c_cirque)

config SHIELD_36CHAMBERS9C_LEFT
    def_bool $(shields_list_contains,36Chambers9c_left)

config SHIELD_36CHAMBERS9C_RIGHT
    def_bool $(shields_list_contains,36Chambers9c_right)
```

## app/boards/shields/36chambers9ex/Kconfig.defconfig
```kconfig
if SHIELD_36CHAMBERS9EX_LEFT

config ZMK_KEYBOARD_NAME
	default "36Chambers9ex"

config ZMK_SPLIT_BLE_ROLE_CENTRAL
	default y

config SPI
    default n

endif

if SHIELD_36CHAMBERS9EX_LEFT || SHIELD_36CHAMBERS9EX_RIGHT

config ZMK_SPLIT
	default y

endif
```

## app/boards/shields/36chambers9ex/Kconfig.shield
```kconfig
config SHIELD_36CHAMBERS9_LEFT
	def_bool $(shields_list_contains,36chambers9ex_left)

config SHIELD_36CHAMBERS9_RIGHT
	def_bool $(shields_list_contains,36chambers9ex_right)
```

## app/boards/shields/36chambers9p/Kconfig.defconfig
```kconfig
if SHIELD_36CHAMBERS9P_LEFT || SHIELD_36CHAMBERS9P_RIGHT

config ZMK_SPLIT
	default y
config SPI
    default y
config ZMK_POINTING
    default y
endif

if SHIELD_36CHAMBERS9P_RIGHT

config ZMK_KEYBOARD_NAME
	default "36chambers9p"

config ZMK_SPLIT_BLE_ROLE_CENTRAL
	default y

endif
```

## app/boards/shields/36chambers9p/Kconfig.shield
```kconfig
config SHIELD_36CHAMBERS9P_LEFT
	def_bool $(shields_list_contains,36chambers9p_left)
    select SPI

config SHIELD_36CHAMBERS9P_RIGHT
	def_bool $(shields_list_contains,36chambers9p_right)
    select SPI
```

## app/boards/shields/36chambers9p2/Kconfig.defconfig
```kconfig
if SHIELD_36CHAMBERS9P2_LEFT || SHIELD_36CHAMBERS9P2_RIGHT

config ZMK_SPLIT
	default y
config SPI
    default y
config I2C
	default y
config ZMK_POINTING
    default y
endif

if SHIELD_36CHAMBERS9P2_LEFT

config ZMK_KEYBOARD_NAME
	default "36chambers9p2"

config ZMK_SPLIT_BLE_ROLE_CENTRAL
	default y

endif
```

## app/boards/shields/36chambers9sr/Kconfig.defconfig
```kconfig
if SHIELD_36CHAMBERS9SR_RIGHT

config ZMK_KEYBOARD_NAME
	default "36chambers9sr"

config ZMK_SPLIT_BLE_ROLE_CENTRAL
	default y
	
config SPI
    default y

config I2C
	default y

config ZMK_POINTING
    default y

endif

if SHIELD_36CHAMBERS9SR_LEFT || SHIELD_36CHAMBERS9SR_RIGHT

config ZMK_SPLIT
	default y

endif
```

## app/boards/shields/36chambers9srp/Kconfig.defconfig
```kconfig
if SHIELD_36CHAMBERS9SRP_LEFT || SHIELD_36CHAMBERS9SRP_RIGHT

config ZMK_SPLIT
	default y
config SPI
    default y
config I2C
	default y
config ZMK_POINTING
    default y
endif

if SHIELD_36CHAMBERS9SRP_LEFT

config ZMK_KEYBOARD_NAME
	default "36chambers9srp"

config ZMK_SPLIT_BLE_ROLE_CENTRAL
	default y

endif
```
