/*
 * Copyright (c) 2020 The ZMK Contributors
 *
 * SPDX-License-Identifier: MIT
west build -d build/36cirque -p -b seeeduino_xiao_ble -- -DSHIELD=36cirque
west build -d build/36cirque -p -b seeeduino_xiao_ble -- -DSHIELD=36cirque -DZMK_EXTRA_MODULES="/workspaces/zmk/app/cirque-input-module-main"

docker cp magical_haslett:/workspaces/zmk/app/build/36cirque/zephyr/zmk.uf2 ~/Desktop/36cirque.uf2

 */

#include <behaviors.dtsi>
#include <dt-bindings/zmk/keys.h>
#include <dt-bindings/zmk/bt.h>
#include <dt-bindings/zmk/outputs.h>
// #include <dt-bindings/zmk/mouse.h>
#include <dt-bindings/zmk/pointing.h>

#define qwerty 0

// #define ZMK_POINTING_DEFAULT_MOVE_VAL 6000  // default: 600
// #define ZMK_POINTING_DEFAULT_SCRL_VAL 30

/ {
    keymap {
        compatible = "zmk,keymap";

        qwerty_layer {
            bindings = <
    &kp ESC        
    >;
        };
    };
};
