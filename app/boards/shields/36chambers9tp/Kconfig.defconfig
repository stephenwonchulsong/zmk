## app/boards/shields/36chambers9tp/Kconfig.defconfig
```kconfig
if SHIELD_36CHAMBERS9TP_LEFT || SHIELD_36CHAMBERS9TP_RIGHT

config ZMK_SPLIT
	default y
config SPI
    default y
config ZMK_POINTING
    default y
endif



if SHIELD_36CHAMBERS9TP_RIGHT

config ZMK_KEYBOARD_NAME
	default "36chambers9tp"

config ZMK_SPLIT_BLE_ROLE_CENTRAL
	default y

endif
```

## app/boards/shields/36chambers9tp/Kconfig.shield
```kconfig
config SHIELD_36CHAMBERS9TP_LEFT
	def_bool $(shields_list_contains,36chambers9tp_left)

config SHIELD_36CHAMBERS9TP_RIGHT
	def_bool $(shields_list_contains,36chambers9tp_right)
```

## app/boards/shields/36chambersV1/Kconfig.defconfig
```kconfig
if SHIELD_36CHAMBERSV1_LEFT

config ZMK_KEYBOARD_NAME
	default "36Chambersv1"

config ZMK_SPLIT_BLE_ROLE_CENTRAL
	default y

endif

if SHIELD_36CHAMBRSV1_LEFT || SHIELD_36CHAMBERSV1_RIGHT

config ZMK_SPLIT
	default y

endif
```

## app/boards/shields/36chambersV1/Kconfig.shield
```kconfig
config SHIELD_36CHAMBERSV1_LEFT
	def_bool $(shields_list_contains,36chambersV1_left)

config SHIELD_36CHAMBERSV1_RIGHT
	def_bool $(shields_list_contains,36chambersV1_right)
```

## app/boards/shields/36chrs9pad/Kconfig.defconfig
```kconfig
if SHIELD_36CHRS9PAD_RIGHT
config ZMK_KEYBOARD_NAME
    default "36chrs9pad"
config ZMK_SPLIT
    default y
config ZMK_POINTING
    default y
config ZMK_SPLIT_BLE_ROLE_CENTRAL
    default y
endif

if SHIELD_36CHRS9PAD_TPAD
config ZMK_POINTING
    default y
config ZMK_SPLIT
    default y
config I2C
    default y
endif

if SHIELD_36CHRS9PAD_LEFT
config ZMK_POINTING
    default y
config ZMK_SPLIT
    default y
endif
```

## app/boards/shields/36chrs9pad/Kconfig.shield
```kconfig
# Copyright (c) 2020 The ZMK Contributors
# SPDX-License-Identifier: MIT

config SHIELD_36CHRS9PAD_RIGHT
	def_bool $(shields_list_contains,36chrs9pad_right)

config SHIELD_36CHRS9PAD_LEFT
    def_bool $(shields_list_contains,36chrs9pad_left)

config SHIELD_36CHRS9PAD_TPAD
    def_bool $(shields_list_contains,36chrs9pad_tpad)
```

## app/boards/shields/TPS/Kconfig.defconfig
```kconfig
if TPS

config ZMK_KEYBOARD_NAME
    default "TPS"

config ZMK_POINTING
    default y

config I2C
	default y

endif
```

## app/boards/shields/TPS43/Kconfig.defconfig
```kconfig
if TPS43

config ZMK_KEYBOARD_NAME
    default "TPS43"

config ZMK_POINTING
    default y

config I2C
	default y

endif
```

## app/boards/shields/TPSnn/Kconfig.defconfig
```kconfig
if TPSNN

config ZMK_KEYBOARD_NAME
    default "TPSNN"

config ZMK_POINTING
    default y

config I2C
	default y

endif
```

## app/boards/shields/TrackPad43/Kconfig.defconfig
```kconfig
if SHIELD_TRACKPAD43

config ZMK_KEYBOARD_NAME
    default "trackpad43"

config ZMK_POINTING
    default y

config I2C
	default y

endif
```

## app/boards/shields/corne/Kconfig.defconfig
```kconfig
config ZMK_POINTING
    default y

if SHIELD_CORNE_LEFT || SHIELD_CORNE_RIGHT
config ZMK_SPLIT
    default y
endif

if SHIELD_CORNE_LEFT
config ZMK_KEYBOARD_NAME
    default "Corne"
config ZMK_SPLIT_ROLE_CENTRAL
    default y
endif

if SHIELD_CORNE_RIGHT
config I2C
    default y
endif
```

## app/dts/bindings/behaviors/zmk,behavior-tp-toggle.yaml
```yaml
# Copyright (c) 2025 ZitaoTech
# SPDX-License-Identifier: MIT

description: Trackpad enable/disable toggle behavior

compatible: "zmk,behavior-tp-toggle"

include: zero_param.yaml
```

## app/kb_zmk_ps2_mouse_trackpoint_driver-main/src/drivers/input/Kconfig
```kconfig
# Copyright (c) 2022 The ZMK Contributors
# SPDX-License-Identifier: MIT

DT_COMPAT_ZMK_INPUT_PS2_MOUSE := zmk,input-mouse-ps2

config ZMK_INPUT_MOUSE_PS2
	bool
	default $(dt_compat_enabled,$(DT_COMPAT_ZMK_INPUT_PS2_MOUSE))
    # depends on (!ZMK_SPLIT || ZMK_SPLIT_ROLE_CENTRAL)
	select ZMK_MOUSE
    select PS2

config ZMK_INPUT_MOUSE_PS2_ENABLE_PS2_RESEND_CALLBACK
	bool "Get notifications from the underluing PS2 protocol driver when the received data is invalid and when a resend is requested from the peripheral. This helps the mouse driver to re-align its command buffer and prevent unexpected clicks and jerky movements. With the ps2-uart driver this option is not really necessary, but is very useful for the ps2-gpio driver where mis-transmissions are frequent."
	default n

if ZMK_INPUT_MOUSE_PS2

config ZMK_INPUT_MOUSE_PS2_POWER_ON_RESET_TIME
    int "The POR shall be timed to occur 600 ms ± 20 % from the time power is applied to the TrackPoint controller."
    default 600
    help
      Refer to IBM TrackPoint System Version 4.0 Engineering Specification - Section 2.1

config ZMK_INPUT_MOUSE_PS2_ENABLE_UROB_COMPAT
    bool "Makes the driver compatible with urob's zmk fork. His fork has commits that change the default zmk function definitions. This option adopts the code to make it compatible with his changes. Only enable it if you are using his fork or it will fail to compile."
	default n

config ZMK_INPUT_MOUSE_PS2_ENABLE_ERROR_MITIGATION
    bool "Tries to mitigate transmission errors. Only useful when using a PS2 driver that is prone to miscommunication like the GPIO bitbanging driver."
	default n

config ZMK_INPUT_MOUSE_PS2_REPORT_INTERVAL_MIN
    int "Minimum report rate. Use to avoid bluetooth queue overflow."
    default 0
    help
      Default minimum report interval in milliseconds.
      Slow down input reporting for hid queue over the air.

config ZMK_INPUT_MOUSE_PS2_ENABLE_CRASH_RECOVERY
    bool "Enable automatic crash recovery using the reset pin"
    default n
    help
      When enabled, the driver will monitor for consecutive errors during
      active use and automatically toggle the reset pin to recover from
      crashes. Requires rst-gpios to be configured in devicetree.

config ZMK_INPUT_MOUSE_PS2_CRASH_RECOVERY_ERROR_THRESHOLD
    int "Number of consecutive errors before triggering crash recovery"
    default 15
    depends on ZMK_INPUT_MOUSE_PS2_ENABLE_CRASH_RECOVERY
    help
      How many consecutive framing errors or packet failures must occur
      before the driver attempts to recover by resetting the trackpoint.

config ZMK_INPUT_MOUSE_PS2_CRASH_RECOVERY_COOLDOWN_MS
    int "Minimum time between crash recovery attempts in milliseconds"
    default 30000
    depends on ZMK_INPUT_MOUSE_PS2_ENABLE_CRASH_RECOVERY
    help
      Prevents recovery loops by enforcing a minimum time between
      consecutive recovery attempts.

endif # ZMK_INPUT_MOUSE_PS2
```
