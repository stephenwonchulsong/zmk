#include "369p.dtsi" // Notice that the main dtsi files are included in the overlay.

/ {
    kscan0: kscan {
        compatible = "zmk,kscan-gpio-matrix";
        diode-direction = "col2row";
    col-gpios
        // = <&xiao_d 10 GPIO_ACTIVE_HIGH>  //Col0
        // , <&xiao_d 9 GPIO_ACTIVE_HIGH>   //Col1
        // , <&xiao_d 8 GPIO_ACTIVE_HIGH>   //Col2
        // , <&xiao_d 7 GPIO_ACTIVE_HIGH>   //Col3
        // , <&xiao_d 5 GPIO_ACTIVE_HIGH>   //Col4
        = <&gpio1 15 GPIO_ACTIVE_HIGH>  //Col0
        , <&gpio1 14 GPIO_ACTIVE_HIGH>   //Col1
        , <&gpio1 13 GPIO_ACTIVE_HIGH>   //Col2
        , <&gpio1 12 GPIO_ACTIVE_HIGH>   //Col3
        , <&gpio0 5 GPIO_ACTIVE_HIGH>   //Col4
        ;
	row-gpios
    	// = <&xiao_d 0 (GPIO_ACTIVE_HIGH | GPIO_PULL_DOWN)>//Row0
        // , <&xiao_d 1 (GPIO_ACTIVE_HIGH | GPIO_PULL_DOWN)>//Row1
        // , <&xiao_d 2 (GPIO_ACTIVE_HIGH | GPIO_PULL_DOWN)>//Row2
        // , <&xiao_d 3 (GPIO_ACTIVE_HIGH | GPIO_PULL_DOWN)>//Row3
        = <&gpio0 2 (GPIO_ACTIVE_HIGH | GPIO_PULL_DOWN)>//Row0
        , <&gpio0 3 (GPIO_ACTIVE_HIGH | GPIO_PULL_DOWN)>//Row1
        , <&gpio0 28 (GPIO_ACTIVE_HIGH | GPIO_PULL_DOWN)>//Row2
        , <&gpio0 29 (GPIO_ACTIVE_HIGH | GPIO_PULL_DOWN)>//Row3
        ;
    };
};